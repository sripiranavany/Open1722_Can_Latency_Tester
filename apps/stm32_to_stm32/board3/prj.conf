## CMakeLists.txt
```
cmake_minimum_required(VERSION 3.20.0)

get_filename_component(OPEN1722_DIR
    "${CMAKE_CURRENT_SOURCE_DIR}/../../../Open1722"
    ABSOLUTE)

find_package(Zephyr REQUIRED HINTS $ENV{ZEPHYR_BASE})
project(avtp_listener)

file(GLOB_RECURSE OPEN1722_SOURCES "${OPEN1722_DIR}/src/*.c")

target_sources(app PRIVATE
    src/main.c
    src/can_handler.c
    src/net_handler.c
    src/avtp_handler.c
    ${OPEN1722_SOURCES}
)

target_include_directories(app PUBLIC
    ${OPEN1722_DIR}/include
)
```

## prj.conf
```kconfig
# Networking stack
CONFIG_NETWORKING=y
CONFIG_NET_L2_ETHERNET=y
CONFIG_ETH_STM32_HAL=y

CONFIG_NET_PKT_RX_COUNT=16
CONFIG_NET_PKT_TX_COUNT=16
CONFIG_NET_BUF_RX_COUNT=64
CONFIG_NET_BUF_TX_COUNT=64

# AF_PACKET raw Ethernet sockets (needed for AVTP)
CONFIG_NET_SOCKETS_PACKET=y

# POSIX API — enables socket(), bind(), recv(), close(), etc.
CONFIG_POSIX_API=y

# Network management events (NET_EVENT_IF_UP)
CONFIG_NET_MGMT=y
CONFIG_NET_MGMT_EVENT=y
CONFIG_NET_DEFAULT_IF_ETHERNET=y


CONFIG_NET_IPV4=n
CONFIG_NET_IPV6=n
CONFIG_NET_TCP=n
CONFIG_NET_UDP=n
CONFIG_NET_STATISTICS=n

# CAN driver (send back to main_pipeline CAN2)
CONFIG_CAN=y
CONFIG_CAN_INIT_PRIORITY=80

# Logging
CONFIG_LOG=n
CONFIG_UART_CONSOLE=n

# Stack sizes
CONFIG_MAIN_STACK_SIZE=4096
```

## boards/nucleo_f439zi.overlay
```dts
/*
 * Board 3 overlay — CAN1 TX back to main_pipeline CAN2 RX
 * Ethernet (&mac, &mdio) already configured in the board DTS.
 */

/* CAN1 — PD0 (RX) / PD1 (TX), 250 kbps — connected to main_pipeline CAN2 */
&can1 {
	status = "okay";
	pinctrl-0 = <&can1_rx_pd0 &can1_tx_pd1>;
	pinctrl-names = "default";
	bus-speed = <250000>;
	sample-point = <875>;
};

/* Disable unused peripherals */
&usart3 {
	status = "disabled";
};

&usart6 {
	status = "disabled";
};

&rtc {
	status = "disabled";
};
```

## src/main.c
```c
#include <zephyr/kernel.h>
#include <zephyr/logging/log.h>
#include <zephyr/posix/sys/socket.h>
#include <unistd.h>
#include "can_handler.h"
#include "net_handler.h"
#include "avtp_handler.h"

LOG_MODULE_REGISTER(avtp_listener, LOG_LEVEL_INF);

int main(void)
{
    uint8_t pdu[MAX_PDU_SIZE];
    int sock, ret;

    ret = can_handler_init();
    if (ret < 0) {
        return ret;
    }

    ret = net_handler_init(&sock);
    if (ret < 0) {
        return ret;
    }

    LOG_INF("AVTP listener + CAN return bridge ready");

    while (1) {
        ret = recv(sock, pdu, sizeof(pdu), 0);
        if (ret < 0) {
            LOG_ERR("recv() failed: %d", errno);
            continue;
        }

        uint32_t ts_us, can_seq, can_id;
        uint8_t avtp_seq;

        if (avtp_parse_frame(pdu, ret, &ts_us, &can_seq, &can_id, &avtp_seq) != 0) {
            continue;
        }

        LOG_INF("[RX] avtp_seq=%u can_id=0x%03x can_seq=%u tx_ts=%u us",
                avtp_seq, can_id, can_seq, ts_us);

        ret = can_send_return(ts_us, can_seq);
        if (ret != 0) {
            LOG_ERR("CAN return TX failed: %d", ret);
        } else {
            LOG_INF("[TX] CAN return: seq=%u ts=%u us", can_seq, ts_us);
        }
    }

    close(sock);
    return 0;
}
```

## src/avtp_handler.c
```c
#include "avtp_handler.h"
#include "can_handler.h"
#include "avtp/acf/Ntscf.h"
#include "avtp/acf/Gpc.h"
#include <string.h>

int avtp_parse_frame(const uint8_t *pdu, int len,
                     uint32_t *ts_us_out, uint32_t *can_seq_out,
                     uint32_t *can_id_out, uint8_t *avtp_seq_out)
{
    if (len < (int)AVTP_NTSCF_HEADER_LEN) {
        return -1;
    }

    const Avtp_Ntscf_t *ntscf = (const Avtp_Ntscf_t *)pdu;
    if (!Avtp_Ntscf_IsValid(ntscf, len)) {
        return -1;
    }

    if (Avtp_Ntscf_GetStreamId(ntscf) != STREAM_ID) {
        return -1;
    }

    *avtp_seq_out = Avtp_Ntscf_GetSequenceNum(ntscf);

    const uint8_t *acf_ptr = pdu + AVTP_NTSCF_HEADER_LEN;
    int remaining           = len - AVTP_NTSCF_HEADER_LEN;

    if (remaining < (int)AVTP_GPC_HEADER_LEN) {
        return -1;
    }

    const Avtp_Gpc_t *gpc = (const Avtp_Gpc_t *)acf_ptr;
    uint16_t acf_total     = Avtp_Gpc_GetAcfMsgLength(gpc) * 4;
    uint16_t payload_len   = acf_total - AVTP_GPC_HEADER_LEN;

    if (payload_len < sizeof(struct can_payload)) {
        return -1;
    }

    struct can_payload cpkt;
    memcpy(&cpkt, acf_ptr + AVTP_GPC_HEADER_LEN, sizeof(cpkt));

    memcpy(ts_us_out,   &cpkt.data[0], sizeof(uint32_t));
    memcpy(can_seq_out, &cpkt.data[4], sizeof(uint32_t));
    *can_id_out = cpkt.can_id;

    return 0;
}
```

## src/avtp_handler.h
```c
#ifndef AVTP_HANDLER_H
#define AVTP_HANDLER_H

#include <stdint.h>

#define STREAM_ID    0xAABBCCDDEEFF0001ULL
#define MAX_PDU_SIZE 1500

int avtp_parse_frame(const uint8_t *pdu, int len,
                     uint32_t *ts_us_out, uint32_t *can_seq_out,
                     uint32_t *can_id_out, uint8_t *avtp_seq_out);

#endif
```

## src/can_handler.c
```c
#include "can_handler.h"
#include <zephyr/kernel.h>
#include <zephyr/logging/log.h>
#include <string.h>

LOG_MODULE_REGISTER(can_handler, LOG_LEVEL_INF);

const struct device *const can1_dev = DEVICE_DT_GET(DT_NODELABEL(can1));

int can_handler_init(void)
{
    if (!device_is_ready(can1_dev)) {
        LOG_ERR("CAN1 device not ready");
        return -ENODEV;
    }

    can_set_mode(can1_dev, CAN_MODE_NORMAL);

    int ret = can_start(can1_dev);
    if (ret != 0) {
        LOG_ERR("CAN1 start failed: %d", ret);
        return ret;
    }

    LOG_INF("CAN1 ready (TX back to main_pipeline)");
    return 0;
}

int can_send_return(uint32_t ts_us, uint32_t seq)
{
    struct can_frame frame = {
        .id    = CAN_RETURN_ID,
        .flags = 0,
        .dlc   = 8,
        .data  = {0},
    };

    memcpy(&frame.data[0], &ts_us, sizeof(uint32_t));
    memcpy(&frame.data[4], &seq,   sizeof(uint32_t));

    return can_send(can1_dev, &frame, K_MSEC(100), NULL, NULL);
}
```

## src/can_handler.h
```c
#ifndef CAN_HANDLER_H
#define CAN_HANDLER_H

#include <zephyr/drivers/can.h>
#include <stdint.h>

#define CAN_RETURN_ID 0x123

struct can_payload {
    uint32_t can_id;
    uint8_t  dlc;
    uint8_t  data[8];
} __packed;

extern const struct device *const can1_dev;

int can_handler_init(void);
int can_send_return(uint32_t ts_us, uint32_t seq);

#endif
```

## src/net_handler.c
```c
#include "net_handler.h"
#include <zephyr/kernel.h>
#include <zephyr/net/net_if.h>
#include <zephyr/net/net_mgmt.h>
#include <zephyr/net/ethernet.h>
#include <zephyr/logging/log.h>
#include <zephyr/posix/sys/socket.h>
#include <arpa/inet.h>
#include <unistd.h>

LOG_MODULE_REGISTER(net_handler, LOG_LEVEL_INF);

static K_SEM_DEFINE(iface_ready, 0, 1);

static void iface_up_handler(struct net_mgmt_event_callback *cb,
                             uint64_t mgmt_event, struct net_if *iface)
{
    if (mgmt_event == NET_EVENT_IF_UP) {
        k_sem_give(&iface_ready);
    }
}

static void wait_for_iface(void)
{
    struct net_if *iface = net_if_get_default();
    struct net_mgmt_event_callback cb;

    if (net_if_is_up(iface)) {
        return;
    }

    net_mgmt_init_event_callback(&cb, iface_up_handler, NET_EVENT_IF_UP);
    net_mgmt_add_event_callback(&cb);
    k_sem_take(&iface_ready, K_FOREVER);
    net_mgmt_del_event_callback(&cb);
}

int net_handler_init(int *sock_out)
{
    struct sockaddr_ll bind_addr = {0};

    LOG_INF("Waiting for Ethernet link...");
    wait_for_iface();
    LOG_INF("Ethernet link up");

    int sock = socket(AF_PACKET, SOCK_DGRAM, htons(ETH_P_TSN));
    if (sock < 0) {
        LOG_ERR("socket() failed: %d", errno);
        return -1;
    }

    bind_addr.sll_family   = AF_PACKET;
    bind_addr.sll_protocol = htons(ETH_P_TSN);
    bind_addr.sll_ifindex  = net_if_get_by_iface(net_if_get_default());

    int ret = bind(sock, (struct sockaddr *)&bind_addr, sizeof(bind_addr));
    if (ret < 0) {
        LOG_ERR("bind() failed: %d", errno);
        close(sock);
        return -1;
    }

    *sock_out = sock;
    return 0;
}
```

## src/net_handler.h
```c
#ifndef NET_HANDLER_H
#define NET_HANDLER_H

int net_handler_init(int *sock_out);

#endif
```
