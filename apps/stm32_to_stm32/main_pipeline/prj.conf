## prj.conf
```kconfig
CONFIG_CAN=y
CONFIG_CAN_STATS=y
CONFIG_GPIO=y
CONFIG_COUNTER=y
# Log settings help with debugging if the bus goes off
CONFIG_LOG=y
CONFIG_LOG_MODE_DEFERRED=y
#CONFIG_CAN_LOG_LEVEL_DBG=y
#CONFIG_CAN_LOG_LEVEL_WRN=y

# Give CAN interrupts higher priority
CONFIG_CAN_INIT_PRIORITY=41

# Increase system clock if not already at max
#           CONFIG_SYS_CLOCK_HW_CYCLES_PER_SEC=168000000
#CONFIG_SYSTEM_CLOCK_HW_CYCLES_PER_SEC_RUNTIME_UPDATE=y

# Optimize kernel
CONFIG_SCHED_SCALABLE=y
CONFIG_TIMESLICING=n

CONFIG_CLOCK_CONTROL=y


# Need to check below settings for logging and shell, as they can cause performance issues
#CONFIG_LOG_BACKEND_UART_OUTPUT_DICTIONARY_HEX=n
#CONFIG_SHELL_VT100_COLORS=n
```

## src/main.c
```c
#include <zephyr/kernel.h>
#include "timestamp.h"
#include "can_handler.h"
#include "button.h"

#define SLEEP_TIME_MS 50

int main(void){
    timestamp_init();
    can_handler_init();
    button_init();

    printk("==========================================\n");
    printk("    CAN Latency Tester - Initialized     \n");
    printk("==========================================\n");
    printk("  Send Interval: %d ms\n", SLEEP_TIME_MS);
    printk("==========================================\n");

    while(1){
        if(can_send_enabled){
            int ret = can_send_frame(tx_sequence_num);
            if(ret != 0){
                printk("[TX] Send failed [%d] seq=%u\n", ret, tx_sequence_num);
            }
            tx_sequence_num++;
        }
        k_msleep(SLEEP_TIME_MS);
    }
    return 0;
}
```

## src/can_handler.c
```c
/*
 * can_handler.c — CAN1 TX / CAN2 RX latency measurement
 *
 * Extended CSV log format (parsed by bridge/mqtt_bridge.py):
 *
 *   CSV,<seq>,<tx_ticks>,<rx_ticks>,<lat_us>,<jit_us>,
 *       <min_us>,<max_us>,<mean_us>,<stddev_us>,<total>,<lost>
 *
 *   Field       Type     Description
 *   ─────────── ──────── ────────────────────────────────────────────
 *   seq         uint32   Frame sequence number (monotonic, from TX)
 *   tx_ticks    uint32   HW timer ticks captured just before can_send()
 *   rx_ticks    uint32   HW timer ticks captured at start of RX callback
 *   lat_us      uint32   One-way latency: ticks_to_us(rx_ticks - tx_ticks)
 *   jit_us      uint32   |lat_us - previous lat_us|
 *   min_us      uint32   Running minimum latency since boot/reset
 *   max_us      uint32   Running maximum latency since boot/reset
 *   mean_us     uint32   Running mean latency (Welford, truncated)
 *   stddev_us   uint32   Running population std-dev (Welford, truncated)
 *   total       uint32   Total RX frames counted
 *   lost        uint32   Frames lost (sequence-number gaps)
 *
 * prj.conf additions needed:
 *   CONFIG_FPU=y
 *   CONFIG_FPU_SHARING=y
 *   CONFIG_NEWLIB_LIBC=y
 */

#include "can_handler.h"
#include "timestamp.h"
#include "stats.h"

#include <string.h>
#include <zephyr/kernel.h>
#include <zephyr/logging/log.h>

LOG_MODULE_REGISTER(can_handler, LOG_LEVEL_INF);

const struct device *const can1_dev = DEVICE_DT_GET(DT_NODELABEL(can1));
const struct device *const can2_dev = DEVICE_DT_GET(DT_NODELABEL(can2));

volatile bool can_send_enabled = false;
uint32_t      tx_sequence_num  = 0;

/* ── RX callback ────────────────────────────────────────────────────────── */

static void can_rx_callback(const struct device *dev,
                             struct can_frame    *frame,
                             void                *user_data)
{
    /* Capture RX timestamp as early as possible */
    uint32_t rx_ticks = get_hw_timestamp_ticks();

    /* Unpack TX timestamp + sequence number from frame payload */
    uint32_t tx_ticks, rx_seq_num;
    memcpy(&tx_ticks,   frame->data,     sizeof(uint32_t));
    memcpy(&rx_seq_num, &frame->data[4], sizeof(uint32_t));

    /* Tick subtraction handles 32-bit wraparound via unsigned underflow */
    uint32_t latency_us = ticks_to_us(rx_ticks - tx_ticks);

    /* Update statistics; returns jitter */
    uint32_t jitter_us = stats_record(latency_us, rx_seq_num);

    /* Grab a consistent snapshot for logging */
    can_stats_snapshot_t snap;
    stats_get_snapshot(&snap);

    /*
     * Extended CSV line — 11 data fields after the "CSV" prefix.
     * The Python bridge (mqtt_bridge.py) parses this and publishes
     * a rich JSON payload to MQTT topic stm32/can/metrics.
     *
     * Field order must match parse_csv_line() in mqtt_bridge.py.
     */
    printk("CSV,%u,%u,%u,%u,%u,%u,%u,%u,%u,%u,%u\n",
           rx_seq_num,
           tx_ticks,
           rx_ticks,
           latency_us,
           jitter_us,
           snap.min_us,
           snap.max_us,
           snap.mean_us,
           snap.stddev_us,
           snap.count,
           snap.lost);
}

/* ── Initialisation ─────────────────────────────────────────────────────── */

int can_handler_init(void)
{
    int ret;

    if (!device_is_ready(can1_dev) || !device_is_ready(can2_dev)) {
        printk("CAN devices not ready\n");
        return -ENODEV;
    }

    /* CAN1 — transmitter */
    can_set_mode(can1_dev, CAN_MODE_NORMAL);
    can_start(can1_dev);

    /* CAN2 — receiver */
    ret = can_set_mode(can2_dev, CAN_MODE_NORMAL);
    if (ret != 0) {
        printk("Error setting CAN2 mode [%d]\n", ret);
        return ret;
    }

    ret = can_start(can2_dev);
    if (ret != 0) {
        printk("Error starting CAN2 [%d]\n", ret);
        return ret;
    }

    /* Accept only frames with ID 0x123 */
    struct can_filter filter = {
        .flags = 0,
        .id    = 0x123,
        .mask  = CAN_STD_ID_MASK,
    };

    int filter_id = can_add_rx_filter(can2_dev, can_rx_callback, NULL, &filter);
    if (filter_id < 0) {
        printk("Error adding CAN2 RX filter [%d]\n", filter_id);
        return filter_id;
    }

    return 0;
}

/* ── TX ─────────────────────────────────────────────────────────────────── */

int can_send_frame(uint32_t seq_num)
{
    struct can_frame frame = {
        .id   = 0x123,
        .flags = 0,
        .dlc  = 8,
        .data = {0},
    };

    /* Pack sequence number first so the RX callback can detect gaps */
    memcpy(&frame.data[4], &seq_num, sizeof(uint32_t));

    /* Capture TX timestamp as late as possible — right before sending */
    uint32_t tx_ticks = get_hw_timestamp_ticks();
    memcpy(frame.data, &tx_ticks, sizeof(uint32_t));

    return can_send(can1_dev, &frame, K_MSEC(100), NULL, NULL);
}
```

## src/can_handler.h
```c
#ifndef CAN_HANDLER_H
#define CAN_HANDLER_H

#include <zephyr/drivers/can.h>
#include <stdbool.h>
#include <stdint.h>

extern const struct device *const can1_dev;
extern const struct device *const can2_dev;
extern volatile bool can_send_enabled;
extern uint32_t tx_sequence_num;

int can_handler_init(void);
int can_send_frame(uint32_t seq_num);

#endif
```

## src/stats.c
```c
#include "stats.h"
#include <zephyr/kernel.h>
#include <limits.h>

struct latency_stats stats = {
    .min_us = UINT32_MAX,
    .max_us = 0,
    .total_us = 0,
    .count = 0,
    .prev_latency_us = 0,
    .total_jitter_us = 0,
    .max_jitter_us = 0,
    .lost_packets = 0,
    .last_rx_seq = 0,
    .sum_sq_us = 0
};

/* Integer square root via Newton's method — no FPU needed */
static uint32_t isqrt64(uint64_t n)
{
    if (n == 0) return 0;
    uint64_t x = n;
    uint64_t y = (x + 1) >> 1;
    while (y < x) {
        x = y;
        y = (x + n / x) >> 1;
    }
    return (uint32_t)x;
}

void stats_reset(void){
    stats.min_us = UINT32_MAX;
    stats.max_us = 0;
    stats.total_us = 0;
    stats.count = 0;
    stats.prev_latency_us = 0;
    stats.total_jitter_us = 0;
    stats.max_jitter_us = 0;
    stats.lost_packets = 0;
    stats.last_rx_seq = 0;
    stats.sum_sq_us = 0;
};

uint32_t stats_record(uint32_t latency_us, uint32_t rx_seq_num) {
    // Packet loss detection
    if (stats.count > 0) {
        uint32_t expected_seq = stats.last_rx_seq + 1;
        if (rx_seq_num != expected_seq) {
            uint32_t lost = rx_seq_num - expected_seq;
            stats.lost_packets += lost;
            /* only print for small gaps — large gaps (e.g. Pi in loop) flood the UART */
            if (lost <= 10) {
                printk("Packet loss: seq gap %u→%u (lost %u)\n",
                       expected_seq, rx_seq_num, lost);
            }
        }
    }
    stats.last_rx_seq = rx_seq_num;

    // Jitter calculation
    uint32_t jitter_us = 0;
    if (stats.count > 0) {
        jitter_us = (latency_us > stats.prev_latency_us) ? (latency_us - stats.prev_latency_us) : (stats.prev_latency_us - latency_us);
        stats.total_jitter_us += jitter_us;
        if (jitter_us > stats.max_jitter_us) {
            stats.max_jitter_us = jitter_us;
        }
    }
    stats.prev_latency_us = latency_us;

    // Min/Max/Total/SumSq
    stats.count++;
    stats.total_us += latency_us;
    stats.sum_sq_us += (uint64_t)latency_us * latency_us;
    if (latency_us < stats.min_us) stats.min_us = latency_us;
    if (latency_us > stats.max_us) stats.max_us = latency_us;
    return jitter_us;
}

void stats_get_snapshot(can_stats_snapshot_t *out)
{
    out->count     = stats.count;
    out->lost      = stats.lost_packets;
    out->min_us    = stats.min_us;
    out->max_us    = stats.max_us;
    out->mean_us   = (stats.count > 0) ? stats.total_us / stats.count : 0;
    out->jitter_us = (stats.count > 1)
                     ? stats.total_jitter_us / (stats.count - 1) : 0;

    /* Population stddev = sqrt(E[X²] - (E[X])²), integer arithmetic only */
    if (stats.count > 1) {
        uint64_t avg_sq  = stats.sum_sq_us / stats.count;
        uint64_t mean_sq = (uint64_t)out->mean_us * out->mean_us;
        uint64_t variance = (avg_sq > mean_sq) ? avg_sq - mean_sq : 0;
        out->stddev_us = isqrt64(variance);
    } else {
        out->stddev_us = 0;
    }
}

void stats_print(uint32_t tx_count)
{
    if (stats.count == 0) return;

    uint32_t avg_latency = stats.total_us / stats.count;
    uint32_t avg_jitter  = (stats.count > 1)
                           ? stats.total_jitter_us / (stats.count - 1) : 0;
    uint64_t avg_sq      = stats.sum_sq_us / stats.count;
    uint64_t mean_sq     = (uint64_t)avg_latency * avg_latency;
    uint32_t stddev      = isqrt64((avg_sq > mean_sq) ? avg_sq - mean_sq : 0);

    printk("\n==========================================\n");
    printk("       LATENCY STATISTICS SUMMARY        \n");
    printk("==========================================\n");
    printk("Messages Sent:     %u\n", tx_count);
    printk("Messages Received: %u\n", stats.count);
    printk("Packets Lost:      %u\n", stats.lost_packets);
    printk("Packet Loss Rate:  %u.%02u%%\n",
           (stats.lost_packets * 100) / tx_count,
           ((stats.lost_packets * 10000) / tx_count) % 100);
    printk("------------------------------------------\n");
    printk("Latency (us):\n");
    printk("  Min:      %u\n", stats.min_us);
    printk("  Max:      %u\n", stats.max_us);
    printk("  Average:  %u\n", avg_latency);
    printk("  Std Dev:  %u\n", stddev);
    printk("  Range:    %u\n", stats.max_us - stats.min_us);
    printk("------------------------------------------\n");
    printk("Jitter (us):\n");
    printk("  Max:      %u\n", stats.max_jitter_us);
    printk("  Average:  %u\n", avg_jitter);
    printk("==========================================\n\n");
}
```

## src/stats.h
```c
#ifndef STATS_H
#define STATS_H

/*
 * stats.h — CAN latency statistics (extended)
 *
 * Uses Welford's online algorithm for mean + population std-dev,
 * which requires only O(1) memory and runs stably for large sample counts.
 *
 * Thread-safety: all functions are protected by an internal Zephyr mutex
 * and safe to call from both the CAN RX ISR thread and a logging thread.
 *
 * Zephyr config needed in prj.conf:
 *   CONFIG_FPU=y               # STM32F4 FPU for double arithmetic
 *   CONFIG_FPU_SHARING=y       # share FPU between threads
 *   CONFIG_NEWLIB_LIBC=y       # for sqrt()  (or use CONFIG_MINIMAL_LIBC
 *                              #   and provide your own isqrt if FP is off)
 */

#include <stdint.h>

#ifdef __cplusplus
extern "C" {
#endif

struct latency_stats {
    uint32_t min_us;
    uint32_t max_us;
    uint32_t total_us;
    uint32_t count;
    uint32_t prev_latency_us;
    uint32_t total_jitter_us;
    uint32_t max_jitter_us;
    uint32_t lost_packets;
    uint32_t last_rx_seq;
    uint64_t sum_sq_us;   /* sum of latency_us^2 — for population stddev */
};

typedef struct {
    uint32_t count;
    uint32_t lost;
    uint32_t min_us;
    uint32_t max_us;
    uint32_t mean_us;
    uint32_t stddev_us;
    uint32_t jitter_us;
} can_stats_snapshot_t;

/**
 * @brief Record a new latency sample.
 *
 * Call from the CAN RX callback after computing latency_us.
 *
 * @param latency_us  One-way frame latency in microseconds.
 * @param seq_num     Sequence number from the CAN frame payload.
 * @return            Jitter (|latency_us - previous latency_us|).
 */
uint32_t stats_record(uint32_t latency_us, uint32_t seq_num);
void stats_get_snapshot(can_stats_snapshot_t *out);
void stats_reset(void);
void stats_print(uint32_t tx_count);

#ifdef __cplusplus
}
#endif

#endif /* STATS_H */
```

## src/timestamp.c
```c
#include "timestamp.h"
#include <zephyr/drivers/counter.h>
#include <zephyr/devicetree.h>

#define TIMER_NODE DT_NODELABEL(counter2)

const struct device *counter_dev = DEVICE_DT_GET(TIMER_NODE);

void timestamp_init(void)
{
    struct counter_top_cfg top_cfg = {
        .callback = NULL,
        .ticks = counter_get_max_top_value(counter_dev),
        .user_data = NULL,
        .flags = 0,
    };

    counter_set_top_value(counter_dev, &top_cfg);
    counter_start(counter_dev);
}

uint32_t get_hw_timestamp_us(void)
{
    uint32_t ticks;
    counter_get_value(counter_dev, &ticks);
    return counter_ticks_to_us(counter_dev, ticks);
}

uint32_t get_hw_timestamp_ticks(void)
{
    uint32_t ticks;
    counter_get_value(counter_dev, &ticks);
    return ticks;
}

uint32_t ticks_to_us(uint32_t ticks)
{
    return counter_ticks_to_us(counter_dev, ticks);
}

uint32_t get_timer_max_us(void)
{
    uint32_t max_ticks = counter_get_max_top_value(counter_dev);
    return counter_ticks_to_us(counter_dev, max_ticks);
}
```

## src/timestamp.h
```c
#ifndef TIMESTAMP_H
#define TIMESTAMP_H

#include <zephyr/device.h>
#include <stdint.h>

extern const struct device *counter_dev; 

void timestamp_init(void);
uint32_t get_hw_timestamp_us(void);
uint32_t get_hw_timestamp_ticks(void);
uint32_t ticks_to_us(uint32_t ticks);
uint32_t get_timer_max_us(void);

#endif
```
